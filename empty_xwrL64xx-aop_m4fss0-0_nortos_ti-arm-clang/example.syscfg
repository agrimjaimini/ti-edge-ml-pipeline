/**
 * @cliArgs --device "XWRL64XX" --part "Default" --package "AOP" --context "m4fss0-0" --product "MMWAVE-L-SDK@05.05.03"
 * @versions {"tool":"1.24.0+4110"}
 */

/**
 * Import the modules used in this configuration.
 */
const uart       = scripting.addModule("/drivers/uart/uart", {}, false);
const uart2      = uart.addInstance();
const debug_log  = scripting.addModule("/kernel/dpl/debug_log");
const mpu_armv7  = scripting.addModule("/kernel/dpl/mpu_armv7", {}, false);
const mpu_armv71 = mpu_armv7.addInstance();
const mpu_armv72 = mpu_armv7.addInstance();
const mpu_armv73 = mpu_armv7.addInstance();

/**
 * Write custom configuration values to the imported modules.
 */
uart2.$name        = "CONFIG_UART1";
uart2.UART.RX.pull = "pu";

debug_log.enableUartLog           = true;
debug_log.uartLog.$name           = "CONFIG_UART0";
debug_log.uartLog.UART.RX.$assign = "PAD_AP";
debug_log.uartLog.UART.TX.$assign = "PAD_AO";

const edma                         = scripting.addModule("/drivers/edma/edma", {}, false);
const edma1                        = edma.addInstance({}, false);
edma1.$name                        = "CONFIG_EDMA0";
debug_log.uartLog.edmaConfig       = edma1;
uart2.edmaConfig                   = edma1;
edma1.edmaRmDmaCh[0].$name         = "CONFIG_EDMA_RM0";
edma1.edmaRmQdmaCh[0].$name        = "CONFIG_EDMA_RM1";
edma1.edmaRmTcc[0].$name           = "CONFIG_EDMA_RM2";
edma1.edmaRmParam[0].$name         = "CONFIG_EDMA_RM3";
edma1.edmaRmReservedDmaCh[0].$name = "CONFIG_EDMA_RM4";

mpu_armv71.$name        = "CONFIG_MPU_REGION0";
mpu_armv71.attributes   = "Device";
mpu_armv71.allowExecute = false;

mpu_armv72.$name    = "CONFIG_MPU_REGION1";
mpu_armv72.baseAddr = 0x400000;
mpu_armv72.size     = 19;

mpu_armv73.$name    = "CONFIG_MPU_REGION2";
mpu_armv73.baseAddr = 0x22400000;
mpu_armv73.size     = 19;

/**
 * Pinmux solution for unlocked pins/peripherals. This ensures that minor changes to the automatic solver in a future
 * version of the tool will not impact the pinmux you originally saw.  These lines can be completely deleted in order to
 * re-solve from scratch.
 */
uart2.UART.$suggestSolution             = "UARTA";
uart2.UART.RX.$suggestSolution          = "PAD_AM";
uart2.UART.TX.$suggestSolution          = "PAD_AN";
debug_log.uartLog.UART.$suggestSolution = "UARTB";
